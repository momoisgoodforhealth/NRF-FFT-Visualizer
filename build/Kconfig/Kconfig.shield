## build/Kconfig/Kconfig.shield
```kconfig
osource "c:/ncs/v2.6.1/zephyr/samples/subsys/display/lvgl/boards/shields/*/Kconfig.shield"
osource "C:/ncs/v2.6.1/nrf/boards/shields/*/Kconfig.shield"
```

## build/Kconfig/Kconfig.shield.defconfig
```kconfig
osource "c:/ncs/v2.6.1/zephyr/samples/subsys/display/lvgl/boards/shields/*/Kconfig.defconfig"
osource "C:/ncs/v2.6.1/nrf/boards/shields/*/Kconfig.defconfig"
```
